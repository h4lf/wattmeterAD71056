/*
 * nokia5110.c
 *
 * Created: 17.05.2016 19:30:03
 *  Author: UB4LAG Vasily Afanasyev
 */ 

#include "pin_macros.h"
#include <util/delay.h>
#include <avr/pgmspace.h>
#include "nokia5110.h"

const unsigned char LcdTable[480] PROGMEM =
{	0x00,0x00,0x00,0x00,0x00,    // 20 space        ASCII table for NOKIA LCD: 96 rows * 5 bytes= 480 bytes
	0x00,0x00,0x5f,0x00,0x00,    // 21 !            Note that this is the same set of codes for character you
	0x00,0x07,0x00,0x07,0x00,    // 22 "            would find on a HD44780 based character LCD. :)
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	0x08,0x1c,0x2a,0x08,0x08	 // 7f Left Arrow    <-
};



void lcd_init_gpio(void)
{
	DRIVER(LCD_SCK, OUT);
	DRIVER(LCD_SDI, OUT);
	DRIVER(LCD_D_C, OUT);
	DRIVER(LCD_SCE, OUT);
	DRIVER(LCD_RES, OUT);
	
	SET(LCD_SCK);
	SET(LCD_SDI);
	SET(LCD_D_C);
	SET(LCD_SCE);
	SET(LCD_RES);
}

void lcd_init(void)
{
	lcd_init_gpio();
	_delay_ms(10);
	CLR(LCD_RES);         // Reset the LCD.
	_delay_ms(100);       // Wait 100ms.
	SET(LCD_RES);          // Awake LCD from RESET state.

	lcd_write_command(0x21);     // Activate Chip and H=1.
	lcd_write_command(0xC2);     // Set LCD Voltage to about 7V.
	lcd_write_command(0x13);     // Adjust voltage bias.
	lcd_write_command(0x20);     // Horizontal addressing and H=0.
	lcd_write_command(0x09);     // Activate all segments.
	lcd_clear_ram();             // Erase all pixel on the DDRAM.
	lcd_write_command(0x08);     // Blank the Display.
	lcd_write_command(0x0C);     // Display Normal.
	lcd_cursor_xy(0,0);          // Cursor Home.
}

void lcd_write_command(uint8_t CommandIn)
{
	CLR(LCD_D_C);				// Select Command register.
	CLR(LCD_SCE);				// Select Chip.
	lcd_clock_data(CommandIn);	// Clock in command bits.
	SET(LCD_SCE);				// Deselect Chip.
}

void lcd_write_data(uint8_t DataIn)
{
	SET(LCD_D_C);				// Select Data register.
	CLR(LCD_SCE);				// Select Chip.
	lcd_clock_data(DataIn);		// Clock in command bits.
	SET(LCD_SCE);				// Deselect Chip.
}

void lcd_clock_data(uint8_t DataIn)
{
	uint8_t i;
	
	for (i=8; i>0; i--)
	{
		CLR(LCD_SCK);
		if (DataIn & 0x80)
		{
			SET(LCD_SDI);
		}
		else
		{
			CLR(LCD_SDI);
		}
		SET(LCD_SCK);
		DataIn <<= 1;
	}
}

void lcd_clear_ram(void)
{
	uint16_t Ddram;

	lcd_cursor_xy(0, 0);	// Cursor Home.
	for (Ddram = 504; Ddram > 0; Ddram--)
	{
		lcd_write_data(0x00);	// 6*84 = 504 DDRAM addresses.
	}
}

void lcd_clear_str(uint8_t Len)		// Очистка строки на N пикселей
{
	uint8_t Count;
	
	for (Count = Len; Count > 0; Count--) lcd_write_data(0x00);
}

void lcd_cursor_xy(unsigned char X, unsigned char Y)// Position cursor to x,y. где x в пикселях, а y номер строки
{
	 lcd_write_command(0x40 | (Y & 0x07));    // Y axis
	 lcd_write_command(0x80 | (X & 0x7f));    // X axis
}

void lcd_put_char(char Character)	// Write one character.
{
	unsigned int Count, CharColumn;

	if ((Character < 0x20) || (Character > 0x7f)) return;		// Exit function if character is not found.

	for (Count = 0; Count < 5; Count++)							// Draw the columns to print the character.
	{
		CharColumn = pgm_read_byte(&(LcdTable[(Character - 32) * 5 + Count]));
		lcd_write_data(CharColumn);
	}
	lcd_write_data(0x00);										// 1 pixel spacing per character.
}

void lcd_put_str_pgm(const char *PtrStr)				// Writes a string of characters (in flash).
{
	uint8_t Character;
	while((Character = pgm_read_byte(PtrStr++)) != '\0')
	{
		lcd_put_char(Character); // Points to one ASCII to be written one at a time.
	}
}

void lcd_put_str_ram(char *PtrStr)			// Writes a string of characters (in RAM).
{
	while( *PtrStr != '\0')
	{
		lcd_put_char(*PtrStr++);
	}
}

void lcd_put_hex_byte(uint8_t Byte)
{
	uint8_t tmp_char;
	tmp_char = ((Byte>>4)&0x0f)+0x30;
	lcd_put_char((tmp_char<0x3a)?tmp_char:(tmp_char+7));
	tmp_char = (Byte&0x0f)+0x30;
	lcd_put_char((tmp_char<0x3a)?tmp_char:(tmp_char+7));
}
